## drivers/iio/dummy-rust/Kconfig
```kconfig
# SPDX-License-Identifier: GPL-2.0-only
#
# Industrial I/O subsystem Dummy Driver configuration
#
menu "Rust IIO dummy driver"
	depends on IIO

config IIO_SIMPLE_DUMMY_RUST
	tristate "An example driver with no hardware requirements with Rust"
	depends on IIO_SW_DEVICE && RUST=y
	help
	  Reimplementation of the software dummy driver in Rust to help with creating
	  the Rust Industrial I/O subsystem

endmenu
```

## drivers/iio/light/cm3232-rust/Kconfig
```kconfig
# SPDX-License-Identifier: GPL-2.0-only
#
# CM3232 Rust driver
#

config CM3232_RUST
	depends on I2C && RUST=y
	tristate "Rust CM3232 ambient light sensor"
	help
	  Say Y here if you use cm3232.
	  This option enables ambient light sensor using
	  Capella Microsystems cm3232 device driver.

	  To compile this driver as a module, choose M here:
	  the module will be called cm3232-rust.
```
